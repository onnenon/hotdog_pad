## boards/shields/hotdog_pad/Kconfig.defconfig
```kconfig
if SHIELD_HOTDOG_PAD

config ZMK_KEYBOARD_NAME
    default "Coviance Hotdog Macropad"

config ZMK_KSCAN_DIRECT_POLLING
    default y

endif
```

## boards/shields/hotdog_pad/Kconfig.shield
```kconfig
# Copyright (c) 2024 Stephen Onnen
# SPDX-License-Identifier: MIT

config SHIELD_HOTDOG_PAD
    def_bool $(shields_list_contains,hotdog_pad)
```
